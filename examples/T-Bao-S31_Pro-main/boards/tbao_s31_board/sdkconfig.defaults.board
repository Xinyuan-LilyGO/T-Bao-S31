## examples/T-Bao-S31_Pro-main/components/espressif__esp_websocket_client/Kconfig
```kconfig
menu "ESP WebSocket client"

    config ESP_WS_CLIENT_ENABLE_DYNAMIC_BUFFER
        bool "Enable websocket client dynamic buffer for send and receive data"
        default n
        help
            Reallocate the websocket buffers for each send/receive operation.
            This reduces the idle buffer footprint when traffic is infrequent.

    config ESP_WS_CLIENT_SEPARATE_TX_LOCK
        bool "Enable separate tx lock for send and receive data"
        default n
        help
            Use a separate lock for transmit operations so senders do not
            contend with the receive path while a frame is being dispatched.

    config ESP_WS_CLIENT_TX_LOCK_TIMEOUT_MS
        int "TX lock timeout in milliseconds"
        depends on ESP_WS_CLIENT_SEPARATE_TX_LOCK
        default 2000
        help
            Maximum time to wait for the websocket transmit lock.

endmenu
```

## examples/T-Bao-S31_Pro-main/main/Kconfig
```kconfig
menu "Xiaozhi Chat Application"
    menuconfig TBAO_CAMERA_SUPPORT
        bool "Enable T-Bao S31 camera"
        default y
        help
            Enable the OV2640/OV3660 PARLIO JPEG camera used by T-Bao S31.

    config TBAO_CAMERA_OV3660
        bool "Use OV3660 camera power profile"
        depends on TBAO_CAMERA_SUPPORT
        default n
        help
            Select this when the fitted camera module is OV3660. The runtime
            probe rejects OV2640 when this profile is selected.

    config TBAO_CAMERA_OV2640_CORE_1V3
        bool "Use 1.3V OV2640 DVDD profile"
        depends on TBAO_CAMERA_SUPPORT && !TBAO_CAMERA_OV3660
        default n
        help
            Select the optional 1.3V OV2640 core-voltage profile. The default
            OV2640 profile is approximately 1.2V.

    choice XIAOZHI_CHAT_APP_TRANSPORT
        prompt "Preferred transport when both MQTT and WebSocket are supported"
        default XIAOZHI_CHAT_APP_TRANSPORT_AUTO
        help
            When the server provides both MQTT and WebSocket, this option selects which to use.
            If "Auto (prefer MQTT)" is selected, MQTT is used when both are available.

        config XIAOZHI_CHAT_APP_TRANSPORT_AUTO
            bool "Auto (prefer MQTT)"
        config XIAOZHI_CHAT_APP_TRANSPORT_MQTT
            bool "MQTT"
        config XIAOZHI_CHAT_APP_TRANSPORT_WEBSOCKET
            bool "WebSocket"
    endchoice
endmenu
```

## examples/audio_test/sdkconfig.defaults
```kconfig
CONFIG_IDF_TARGET="esp32s31"
CONFIG_ESPTOOLPY_FLASHSIZE_16MB=y
CONFIG_ESPTOOLPY_HEADER_FLASHSIZE_UPDATE=y
```

## examples/camera_display/sdkconfig.defaults
```kconfig
CONFIG_IDF_TARGET="esp32s31"
CONFIG_ESPTOOLPY_FLASHSIZE_16MB=y
CONFIG_COMPILER_OPTIMIZATION_PERF=y
CONFIG_ESP_CAM_IO_PARL_PAYLOAD_SIZE=16384
CONFIG_ESP_CAM_IO_PARL_SCCB_I2C_PORT1=y
CONFIG_ESP_CAM_IO_PARL_SCCB_I2C_PORT0=n
CONFIG_ESP_CAM_IO_PARL_OV2640=y
CONFIG_ESP_CAM_IO_PARL_OV3660=y
CONFIG_ESP_CAM_IO_PARL_OV5640=n
CONFIG_ESP_CAM_IO_PARL_NT99141=n
CONFIG_ESP_CAM_IO_PARL_FRAME_SIZE_AUTO=y
CONFIG_ESP_CAM_IO_PARL_FRAME_SIZE_MUL=1
CONFIG_ESP_CAM_IO_PARL_FRAME_SIZE_DIV=2
CONFIG_ESP_CAM_IO_PARL_FRAME_SIZE_PADDING=8192
```

## examples/charger_test/sdkconfig.defaults
```kconfig
CONFIG_ESPTOOLPY_FLASHSIZE_16MB=y
CONFIG_ESPTOOLPY_HEADER_FLASHSIZE_UPDATE=y
CONFIG_LV_BUILD_EXAMPLES=n
CONFIG_LV_BUILD_DEMOS=n
CONFIG_XL9555_DEFAULT_OUTPUT=0xFFFF
```

## examples/factory_test/sdkconfig.defaults
```kconfig
CONFIG_IDF_TARGET="esp32s31"
CONFIG_ESPTOOLPY_FLASHSIZE_16MB=y
CONFIG_ESPTOOLPY_HEADER_FLASHSIZE_UPDATE=y
CONFIG_PARTITION_TABLE_CUSTOM=y
CONFIG_PARTITION_TABLE_CUSTOM_FILENAME="partitions.csv"
CONFIG_PARTITION_TABLE_FILENAME="partitions.csv"
CONFIG_ESP_WIFI_SOFTAP_SUPPORT=n
CONFIG_LV_BUILD_EXAMPLES=n
CONFIG_LV_BUILD_DEMOS=n
CONFIG_LV_FONT_MONTSERRAT_20=y
CONFIG_LV_FONT_MONTSERRAT_24=y
CONFIG_XL9555_DEFAULT_OUTPUT=0xFC5F
CONFIG_FATFS_VFS_FSTAT_BLKSIZE=4096
CONFIG_COMPILER_OPTIMIZATION_PERF=y
CONFIG_ESP_CAM_IO_PARL_PAYLOAD_SIZE=16384
CONFIG_ESP_CAM_IO_PARL_SCCB_I2C_PORT1=y
CONFIG_ESP_CAM_IO_PARL_SCCB_I2C_PORT0=n
CONFIG_ESP_CAM_IO_PARL_OV2640=y
CONFIG_ESP_CAM_IO_PARL_OV3660=y
CONFIG_ESP_CAM_IO_PARL_OV5640=n
CONFIG_ESP_CAM_IO_PARL_NT99141=n
CONFIG_ESP_CAM_IO_PARL_FRAME_SIZE_AUTO=y
CONFIG_ESP_CAM_IO_PARL_FRAME_SIZE_MUL=1
CONFIG_ESP_CAM_IO_PARL_FRAME_SIZE_DIV=2
CONFIG_ESP_CAM_IO_PARL_FRAME_SIZE_PADDING=8192
```

## examples/motor_servo_web_control/sdkconfig.defaults
```kconfig
CONFIG_IDF_TARGET="esp32s31"
CONFIG_ESPTOOLPY_FLASHSIZE_16MB=y
CONFIG_ESPTOOLPY_HEADER_FLASHSIZE_UPDATE=y
CONFIG_PARTITION_TABLE_SINGLE_APP_LARGE=y
CONFIG_ESP_WIFI_SOFTAP_SUPPORT=n
CONFIG_LV_BUILD_EXAMPLES=n
CONFIG_LV_BUILD_DEMOS=n
CONFIG_XL9555_DEFAULT_OUTPUT=0xF7DF
```

## examples/sdcard_test/sdkconfig.defaults
```kconfig
CONFIG_IDF_TARGET="esp32s31"
CONFIG_ESPTOOLPY_FLASHSIZE_16MB=y
CONFIG_ESPTOOLPY_HEADER_FLASHSIZE_UPDATE=y
CONFIG_XL9555_DEFAULT_OUTPUT=0xFFFF
CONFIG_FATFS_VFS_FSTAT_BLKSIZE=4096
```
